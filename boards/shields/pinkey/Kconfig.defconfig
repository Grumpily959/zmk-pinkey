## boards/shields/pinkey/Kconfig.defconfig
```kconfig
if SHIELD_PINKEY_LEFT

# Name must be less than 16 characters long!
config ZMK_KEYBOARD_NAME
    default "PinKey"

config ZMK_SPLIT_ROLE_CENTRAL
    default y

endif

if SHIELD_PINKEY_LEFT || SHIELD_PINKEY_RIGHT

config ZMK_SPLIT
    default y

endif
```

## boards/shields/pinkey/Kconfig.shield
```kconfig
config SHIELD_PINKEY_LEFT
    def_bool $(shields_list_contains,pinkey_left)

config SHIELD_PINKEY_RIGHT
    def_bool $(shields_list_contains,pinkey_right)
```
